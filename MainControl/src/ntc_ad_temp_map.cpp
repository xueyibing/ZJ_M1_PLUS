#include "ntc_ad_temp_map.h"
#include <stdint.h>

#define NTC_3K_DOWN_TEMP_OFFSET_C (-16)
#define NTC_5K1_DOWN_TEMP_OFFSET_C (0)
#define NTC_20K_UP_TEMP_OFFSET_C (0)

namespace ntc_ad_temp_map
{
namespace
{
constexpr int TEMP_MIN = -30;
constexpr int TEMP_MAX = 300;
constexpr int TABLE_N  = 331;
constexpr int ADC_MAX  = 4095;
constexpr int PULLUP_20K_OHM = 20000;
constexpr int PULLDOWN_5K1_OHM = 5100;

int applyTempOffset(int tempValue, int offsetC)
{
  int adjusted = tempValue + offsetC;
  if (adjusted < TEMP_MIN)
  {
    return TEMP_MIN;
  }
  if (adjusted > TEMP_MAX)
  {
    return TEMP_MAX;
  }
  return adjusted;
}

int downAdToEquivalent20KUpAd(int adcValue, int pullDownOhm)
{
  if (adcValue <= 0)
  {
    return ADC_MAX;
  }
  if (adcValue >= ADC_MAX)
  {
    return 0;
  }

  int64_t numerator = (int64_t)ADC_MAX * pullDownOhm * (ADC_MAX - adcValue);
  int64_t denominator = (int64_t)PULLUP_20K_OHM * adcValue + (int64_t)pullDownOhm * (ADC_MAX - adcValue);
  return (int)((numerator + denominator / 2) / denominator);
}

// 温度↑ AD↓（单调递减）
const uint16_t AD_UP_3K[TABLE_N] = {
    4088, 4087, 4087, 4087, 4086, 4085, 4085, 4084, 4084, 4083, 4082, 4081, 4081, 4080, 4079, 4078,
    4077, 4076, 4075, 4074, 4073, 4072, 4070, 4069, 4068, 4066, 4065, 4063, 4061, 4060, 4058, 4056,
    4054, 4052, 4050, 4047, 4045, 4043, 4040, 4037, 4034, 4032, 4028, 4025, 4022, 4019, 4015, 4011,
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    145,  143,  141,  139,  137,  135,  133,  131,  129,  127,  126,
};

// 温度↑ AD↑（单调递增）
const uint16_t AD_DOWN_3K[TABLE_N] = {
       7,    8,    8,    8,    9,   10,   10,   11,   11,   12,   13,   14,   14,   15,   16,   17,
      18,   19,   20,   21,   22,   23,   25,   26,   27,   29,   30,   32,   34,   35,   37,   39,
      41,   43,   45,   48,   50,   52,   55,   58,   61,   63,   67,   70,   73,   76,   80,   84,
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    3950, 3952, 3954, 3956, 3958, 3960, 3962, 3964, 3966, 3968, 3969,
};

  // 温度↑ AD↓（单调递减），对应 Excel 中 IGBTAD值(20k上拉)
  const uint16_t AD_UP_20K[TABLE_N] = {
    4048, 4045, 4042, 4039, 4036, 4032, 4028, 4024, 4020, 4016, 4011, 4007, 4002, 3996, 3991, 3985,
    3979, 3973, 3966, 3959, 3952, 3944, 3936, 3928, 3919, 3910, 3901, 3891, 3881, 3870, 3859, 3848,
    3836, 3823, 3810, 3797, 3783, 3769, 3754, 3739, 3723, 3706, 3689, 3671, 3653, 3634, 3614, 3594,
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      22,   22,   22,   21,   21,   21,   21,   20,   20,   20,   19,
  };

int adToTemp20KUpBase(int adcValue)
{
  if (adcValue >= AD_UP_20K[0])
  {
    return TEMP_MIN;
  }
  if (adcValue <= AD_UP_20K[TABLE_N - 1])
  {
    return TEMP_MAX;
  }
  // 二分：AD_UP_20K[hi] <= adcValue < AD_UP_20K[lo]
  int lo = 0;
  int hi = TABLE_N - 1;
  while (hi - lo > 1)
  {
    int mid = (lo + hi) >> 1;
    if (AD_UP_20K[mid] > adcValue)
    {
      lo = mid;
    }
    else
    {
      hi = mid;
    }
  }
  int ad_lo = AD_UP_20K[lo]; // 较大
  int ad_hi = AD_UP_20K[hi]; // 较小
  int t_lo  = TEMP_MIN + lo;
  int span  = ad_lo - ad_hi;
  if (span <= 0)
  {
    return t_lo;
  }
  int delta = ad_lo - adcValue;
  return t_lo + (delta + span / 2) / span;
}
} // namespace



// 下拉接法：表为单调递增
int adToTemp3KDown(int adcValue)
{
  if (adcValue <= AD_DOWN_3K[0])
  {
    return applyTempOffset(TEMP_MIN, NTC_3K_DOWN_TEMP_OFFSET_C);
  }
  if (adcValue >= AD_DOWN_3K[TABLE_N - 1])
  {
    return applyTempOffset(TEMP_MAX, NTC_3K_DOWN_TEMP_OFFSET_C);
  }
  // 二分：AD_DOWN_3K[lo] <= adcValue < AD_DOWN_3K[hi]
  int lo = 0;
  int hi = TABLE_N - 1;
  while (hi - lo > 1)
  {
    int mid = (lo + hi) >> 1;
    if (AD_DOWN_3K[mid] <= adcValue)
    {
      lo = mid;
    }
    else
    {
      hi = mid;
    }
  }
  int ad_lo = AD_DOWN_3K[lo]; // 较小
  int ad_hi = AD_DOWN_3K[hi]; // 较大
  int t_lo  = TEMP_MIN + lo;
  int span  = ad_hi - ad_lo;
  if (span <= 0)
  {
    return applyTempOffset(t_lo, NTC_3K_DOWN_TEMP_OFFSET_C);
  }
  int delta = adcValue - ad_lo;
  return applyTempOffset(t_lo + (delta + span / 2) / span, NTC_3K_DOWN_TEMP_OFFSET_C);
}

int adToTemp5K1Down(int adcValue)
{
  int equivalent20KUpAd = downAdToEquivalent20KUpAd(adcValue, PULLDOWN_5K1_OHM);
  return applyTempOffset(adToTemp20KUpBase(equivalent20KUpAd), NTC_5K1_DOWN_TEMP_OFFSET_C);
}

int adToTemp20KUp(int adcValue)
{
  return applyTempOffset(adToTemp20KUpBase(adcValue), NTC_20K_UP_TEMP_OFFSET_C);
}

} // namespace ntc_ad_temp_map
